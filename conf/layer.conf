## conf/machine/sd-600eval.conf
```bitbake
#@TYPE: Machine
#@NAME: SD 600eval
#@DESCRIPTION: Machine configuration for the Arrow SD 600eval, with Qualcomm Snapdragon 600 APQ8064.

require conf/machine/include/qcom-apq8064.inc

MACHINE_FEATURES = "usbhost usbgadget alsa screen wifi bluetooth ext2"

MACHINE_EXTRA_RRECOMMENDS = " \
    kernel-modules \
    ${@bb.utils.contains('DISTRO_FEATURES', 'opengl', 'mesa-driver-msm', '', d)} \
    ${@bb.utils.contains('DISTRO_FEATURES', 'bluez5', 'bluez5-noinst-tools', '', d)} \
    firmware-qcom-sd-600eval \
"

KERNEL_IMAGETYPE ?= "zImage"
KERNEL_DEVICETREE ?= "qcom-apq8064-arrow-sd-600eval.dtb"

SERIAL_CONSOLE ?= "115200 ttyMSM0"

QCOM_BOOTIMG_ROOTFS ?= "mmcblk0p12"
```

## conf/machine/sdx55-mtp.conf
```bitbake
#@TYPE: Machine
#@NAME: SDX55-MTP
#@DESCRIPTION: Machine configuration for the SDX55-MTP development board, with Qualcomm SDX55.

require conf/machine/include/qcom-sdx55.inc

MACHINE_FEATURES = "usbhost usbgadget"

KERNEL_IMAGETYPE ?= "zImage"
KERNEL_DEVICETREE ?= "qcom-sdx55-mtp.dtb"

# UBI filesystem parameters
MKUBIFS_ARGS ?= "-m 4096 -e 253952 -c 1188"
UBINIZE_ARGS ?= "-m 4096 -p 256KiB -s 4096"

# Use system partition for rootfs
UBI_VOLNAME ?= "system"
QCOM_BOOTIMG_ROOTFS ?= "ubi0:system"

SERIAL_CONSOLES ?= "115200;ttyMSM0"

PREFERRED_PROVIDER_virtual/kernel = "linux-linaro-qcomlt-dev"
```

## conf/machine/sdx55-telit-fn980.conf
```bitbake
#@TYPE: Machine
#@NAME: SDX55-TELIT-FN980
#@DESCRIPTION: Machine configuration for the Telit FN980 development board, with Qualcomm SDX55.

require conf/machine/include/qcom-sdx55.inc

MACHINE_FEATURES = "usbhost usbgadget"

KERNEL_IMAGETYPE ?= "zImage"
KERNEL_DEVICETREE ?= "qcom-sdx55-telit-fn980.dtb"

# UBI filesystem parameters
MKUBIFS_ARGS ?= "-m 4096 -e 253952 -c 528"
UBINIZE_ARGS ?= "-m 4096 -p 256KiB -s 4096"

# Use system partition for rootfs
UBI_VOLNAME ?= "system"
QCOM_BOOTIMG_ROOTFS ?= "ubi0:system"

SERIAL_CONSOLES = "921600;ttyMSM0"

PREFERRED_PROVIDER_virtual/kernel = "linux-linaro-qcomlt-dev"
```

## conf/machine/sm8250-mtp.conf
```bitbake
#@TYPE: Machine
#@NAME: SM8250-MTP
#@DESCRIPTION: Machine configuration for the SM8250-MTP development board, with Qualcomm Snapdragon 865 SM8250.

require conf/machine/include/qcom-sm8250.inc

MACHINE_FEATURES = "usbhost usbgadget alsa screen wifi bluetooth ext2"

KERNEL_IMAGETYPE ?= "Image.gz"
KERNEL_DEVICETREE ?= "qcom/sm8250-mtp.dtb"

SERIAL_CONSOLE ?= "115200 ttyMSM0"

MACHINE_ESSENTIAL_EXTRA_RRECOMMENDS += " \
    kernel-modules \
    ${@bb.utils.contains('DISTRO_FEATURES', 'bluetooth', 'linux-firmware-qca', '', d)} \
    ${@bb.utils.contains('DISTRO_FEATURES', 'opengl', 'mesa-driver-msm', '', d)} \
"
# linux-firmware-qcom-adreno-a650 

# /dev/sda15 is 'userdata' partition, so wipe it and use for our build
QCOM_BOOTIMG_ROOTFS ?= "sda15"

# UFS partitions setup with 4096 logical sector size
EXTRA_IMAGECMD_ext4 += " -b 4096 "
```
