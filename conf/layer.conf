## conf/layer.conf
```bitbake
# We have a conf and classes directory, add to BBPATH
BBPATH .= ":${LAYERDIR}"

# We have a packages directory, add to BBFILES
BBFILES += "${LAYERDIR}/recipes-*/*/*.bb \
            ${LAYERDIR}/recipes-*/*/*.bbappend"

BBFILE_COLLECTIONS += "qcom"
BBFILE_PATTERN_qcom := "^${LAYERDIR}/"
BBFILE_PRIORITY_qcom = "5"

QCOM_EULA_FILE = "${LAYERDIR}/conf/eula/${MACHINE}"

# Let us add layer-specific bbappends which are only applied when that
# layer is included in our configuration
# includes customization and/or backports
BBFILES += "${@' '.join('${LAYERDIR}/%s/recipes*/*/*.bbappend' % layer \
              for layer in BBFILE_COLLECTIONS.split())}"
# Add layer-specific bb files too
BBFILES += "${@' '.join('${LAYERDIR}/%s/recipes*/*/*.bb' % layer \
              for layer in BBFILE_COLLECTIONS.split())}"
```

## conf/machine/dragonboard-410c-32.conf
```bitbake
#@TYPE: Machine
#@NAME: dragonboard-410c-32
#@DESCRIPTION: 32-bit machine configuration for the DragonBoard 410c (96boards), with Qualcomm Snapdragon 410 APQ8016.

require conf/machine/include/qcom-apq8016.inc
require conf/machine/include/tune-cortexa8.inc

MACHINE_FEATURES = "usbhost usbgadget alsa screen wifi bluetooth ext2"

SERIAL_CONSOLE ?= "115200 ttyMSM0"

# Building 32-bit kernel is not supported.
PREFERRED_PROVIDER_virtual/kernel = "linux-dummy"
RDEPENDS_kernel-base = ""

MACHINE_ESSENTIAL_EXTRA_RRECOMMENDS += " \
    ${@bb.utils.contains('DISTRO_FEATURES', 'opengl', 'mesa-driver-msm', '', d)} \
    ${@bb.utils.contains('DISTRO_FEATURES', 'bluez5', 'bluez5-noinst-tools', '', d)} \
    firmware-qcom-dragonboard410c \
"
```

## conf/machine/dragonboard-410c.conf
```bitbake
#@TYPE: Machine
#@NAME: dragonboard-410c
#@DESCRIPTION: Machine configuration for the DragonBoard 410c (96boards), with Qualcomm Snapdragon 410 APQ8016.

require conf/machine/include/qcom-apq8016.inc
require conf/machine/include/tune-cortexa53.inc

MACHINE_FEATURES = "usbhost usbgadget alsa screen wifi bluetooth ext2"

KERNEL_IMAGETYPE ?= "Image.gz"
KERNEL_DEVICETREE ?= "qcom/apq8016-sbc.dtb"

SERIAL_CONSOLE ?= "115200 ttyMSM0"

MACHINE_ESSENTIAL_EXTRA_RRECOMMENDS += " \
    kernel-modules \
    ${@bb.utils.contains('DISTRO_FEATURES', 'opengl', 'linux-firmware-qcom-adreno-a3xx mesa-driver-msm', '', d)} \
    ${@bb.utils.contains('DISTRO_FEATURES', 'bluez5', 'bluez5-noinst-tools', '', d)} \
    firmware-qcom-dragonboard410c \
    linux-firmware-qcom-venus-1.8 \
"

QCOM_BOOTIMG_ROOTFS ?= "mmcblk0p14"

# Define rootfs partiton (kernel argument)
SD_QCOM_BOOTIMG_ROOTFS ?= "mmcblk1p7"

UBOOT_MACHINE ?= "dragonboard410c_defconfig"

# Assemble SD card
IMAGE_FSTYPES += "wic.gz wic.bmap"
WKS_FILE = "dragonboard410c-sd.wks"
WKS_FILE_DEPENDS = "firmware-qcom-dragonboard410c-bootloader-sdcard"
```

## conf/machine/dragonboard-600c.conf
```bitbake
#@TYPE: Machine
#@NAME: Dragonboard 600c
#@DESCRIPTION: Machine configuration for the Dragonboard 600c, with Qualcomm Snapdragon 600 APQ8064.

require conf/machine/include/qcom-apq8064.inc

MACHINE_FEATURES = "usbhost usbgadget alsa screen wifi bluetooth ext2"

MACHINE_EXTRA_RRECOMMENDS = " \
    kernel-modules \
    ${@bb.utils.contains('DISTRO_FEATURES', 'opengl', 'mesa-driver-msm', '', d)} \
    ${@bb.utils.contains('DISTRO_FEATURES', 'bluez5', 'bluez5-noinst-tools', '', d)} \
    firmware-qcom-sd-600eval \
"

KERNEL_IMAGETYPE ?= "zImage"
KERNEL_DEVICETREE ?= "qcom-apq8064-db600c.dtb"

SERIAL_CONSOLE ?= "115200 ttyMSM0"

QCOM_BOOTIMG_ROOTFS ?= "mmcblk0p12"
```

## conf/machine/dragonboard-820c-32.conf
```bitbake
#@TYPE: Machine
#@NAME: dragonboard-820c-32
#@DESCRIPTION: 32-bit Machine configuration for the DragonBoard 820c (96boards), with Qualcomm Snapdragon 820 APQ8096.

require conf/machine/include/qcom-apq8096.inc

MACHINE_FEATURES = "usbhost usbgadget alsa screen wifi bluetooth ext2"

# Building 32-bit kernel is not supported.
PREFERRED_PROVIDER_virtual/kernel = "linux-dummy"
RDEPENDS_kernel-base = ""

SERIAL_CONSOLE = "115200 ttyMSM0"

MACHINE_ESSENTIAL_EXTRA_RRECOMMENDS += " \
"

QCOM_BOOTIMG_ROOTFS ?= "sde18"

# UFS partitions setup with 4096 logical sector size
EXTRA_IMAGECMD_ext4 += " -b 4096 "
```

## conf/machine/dragonboard-820c.conf
```bitbake
#@TYPE: Machine
#@NAME: dragonboard-820c
#@DESCRIPTION: Machine configuration for the DragonBoard 820c (96boards), with Qualcomm Snapdragon 820 APQ8096.

require conf/machine/include/qcom-apq8096.inc

MACHINE_FEATURES = "usbhost usbgadget alsa screen wifi bluetooth ext2"

KERNEL_IMAGETYPE ?= "Image.gz"
KERNEL_DEVICETREE ?= "qcom/apq8096-db820c.dtb"

SERIAL_CONSOLE ?= "115200 ttyMSM0"

MACHINE_ESSENTIAL_EXTRA_RRECOMMENDS += " \
    kernel-modules \
    ${@bb.utils.contains('DISTRO_FEATURES', 'opengl', 'mesa-driver-msm', '', d)} \
    packagegroup-firmware-dragonboard820c \
"

QCOM_BOOTIMG_ROOTFS ?= "/dev/sda1"

UBOOT_MACHINE ?= "dragonboard820c_defconfig"

# UFS partitions setup with 4096 logical sector size
EXTRA_IMAGECMD:ext4 += " -b 4096 "
```

## conf/machine/dragonboard-845c.conf
```bitbake
#@TYPE: Machine
#@NAME: dragonboard-845c
#@DESCRIPTION: Machine configuration for the DragonBoard 845c (96boards), with Qualcomm Snapdragon 845 SDM845.

require conf/machine/include/qcom-sdm845.inc

MACHINE_FEATURES = "usbhost usbgadget alsa screen wifi bluetooth ext2"

KERNEL_IMAGETYPE ?= "Image.gz"
KERNEL_DEVICETREE ?= "qcom/sdm845-db845c.dtb"
KERNEL_CMDLINE_EXTRA ?= "clk_ignore_unused pd_ignore_unused"

SERIAL_CONSOLE ?= "115200 ttyMSM0"

MACHINE_ESSENTIAL_EXTRA_RRECOMMENDS += " \
    kernel-modules \
    ${@bb.utils.contains('DISTRO_FEATURES', 'opengl', 'mesa-driver-msm', '', d)} \
    packagegroup-firmware-dragonboard845c \
"

# /dev/sda1 is 'rootfs' partition after installing the latest bootloader package from linaro
QCOM_BOOTIMG_ROOTFS ?= "/dev/sda1"

# UFS partitions setup with 4096 logical sector size
EXTRA_IMAGECMD:ext4 += " -b 4096 "
```

## conf/machine/evb4k-qcs404.conf
```bitbake
#@TYPE: Machine
#@NAME: evb4k-qcs404
#@DESCRIPTION: Machine configuration for the EVB-4K QCS404 with Qualcomm QCS404.

require conf/machine/include/qcom-qcs404.inc
require conf/machine/include/tune-cortexa53.inc

MACHINE_FEATURES = "usbhost usbgadget ext2"

KERNEL_IMAGETYPE ?= "Image.gz"
KERNEL_DEVICETREE ?= "qcom/qcs404-evb-4000.dtb"

SERIAL_CONSOLE ?= "115200 ttyMSM0"

MACHINE_ESSENTIAL_EXTRA_RRECOMMENDS += " \
    kernel-modules \
"

QCOM_BOOTIMG_ROOTFS ?= "mmcblk0p27"
```

## conf/machine/ifc6410.conf
```bitbake
#@TYPE: Machine
#@NAME: ifc6410
#@DESCRIPTION: Machine configuration for the Inforce IFC6410, with Qualcomm Snapdragon 600 APQ8064.

require conf/machine/include/qcom-apq8064.inc

# features
MACHINE_FEATURES = "alsa kernel26 screen usb keyboard wifi ext2 ext3"

MACHINE_EXTRA_RRECOMMENDS = " \
    kernel-modules \
    ${@bb.utils.contains('DISTRO_FEATURES', 'opengl', 'mesa-driver-msm', '', d)} \
"

KERNEL_IMAGETYPE ?= "zImage"
KERNEL_DEVICETREE ?= "qcom-apq8064-ifc6410.dtb"

SERIAL_CONSOLE ?= "115200 ttyMSM0"

QCOM_BOOTIMG_ROOTFS ?= "mmcblk0p12"

INHERIT += "qcom-firmware-mount"
```

## conf/machine/include/qcom-apq8016.inc
```bitbake
SOC_FAMILY = "apq8016"
require conf/machine/include/qcom-common.inc

MACHINE_ESSENTIAL_EXTRA_RRECOMMENDS += " \
    qrtr \
    rmtfs \
"

MACHINE_EXTRA_RRECOMMENDS += " \
    fastrpc \
"

# Android boot image settings
QCOM_BOOTIMG_PAGE_SIZE = "2048"
```

## conf/machine/include/qcom-apq8064.inc
```bitbake
SOC_FAMILY = "apq8064"
require conf/machine/include/qcom-common.inc
require conf/machine/include/tune-cortexa8.inc

# Android boot image settings
QCOM_BOOTIMG_PAGE_SIZE = "2048"
```

## conf/machine/include/qcom-apq8096-32.inc
```bitbake
SOC_FAMILY = "apq8096"
require conf/machine/include/soc-family.inc
require conf/machine/include/tune-cortexa8.inc

PREFERRED_PROVIDER_virtual/egl ?= "mesa"
PREFERRED_PROVIDER_virtual/libgl ?= "mesa"
PREFERRED_PROVIDER_virtual/libgles1 ?= "mesa"
PREFERRED_PROVIDER_virtual/libgles2 ?= "mesa"
PREFERRED_PROVIDER_virtual/xserver ?= "xserver-xorg"

# Fastboot expects an ext4 image, which needs to be 4096 aligned
IMAGE_FSTYPES_append = " ext4.gz"
IMAGE_ROOTFS_ALIGNMENT = "4096"
```

## conf/machine/include/qcom-apq8096.inc
```bitbake
SOC_FAMILY = "apq8096"
require conf/machine/include/qcom-common.inc
require conf/machine/include/arm/arch-armv8a.inc

MACHINE_ESSENTIAL_EXTRA_RRECOMMENDS += " \
    qrtr \
    rmtfs \
"

MACHINE_EXTRA_RRECOMMENDS += " \
    fastrpc \
"
```

## conf/machine/include/qcom-common.inc
```bitbake
SOC_FAMILY:prepend = "qcom:"
require conf/machine/include/soc-family.inc

XSERVER_OPENGL ?= " \
    xf86-video-modesetting \
    xserver-xorg-extension-glx \
"

XSERVER ?= " \
    xserver-xorg \
    xserver-xorg-module-libint10 \
    ${@bb.utils.contains('DISTRO_FEATURES', 'opengl', '${XSERVER_OPENGL}', 'xf86-video-fbdev', d)} \
    xf86-input-evdev \
"

PREFERRED_PROVIDER_virtual/egl ?= "mesa"
PREFERRED_PROVIDER_virtual/libgl ?= "mesa"
PREFERRED_PROVIDER_virtual/libgles1 ?= "mesa"
PREFERRED_PROVIDER_virtual/libgles2 ?= "mesa"
PREFERRED_PROVIDER_virtual/xserver ?= "xserver-xorg"
PREFERRED_PROVIDER_virtual/kernel ??= "linux-linaro-qcomlt"

PREFERRED_PROVIDER_android-tools-conf = "android-tools-conf-configfs"

# Fastboot expects an ext4 image, which needs to be 4096 aligned
IMAGE_FSTYPES ?= "ext4.gz"
IMAGE_ROOTFS_ALIGNMENT ?= "4096"

# Android boot image settings
QCOM_BOOTIMG_KERNEL_BASE ?= "0x80000000"
QCOM_BOOTIMG_PAGE_SIZE ?= "4096"

# Default serial console for QCOM devices
SERIAL_CONSOLES ?= "115200;ttyMSM0"

# Increase INITRAMFS_MAXSIZE to 384 MiB to cover initramfs-kerneltest-full
# image.  All our boards (except db410c) have 2GiB and db410c has 1GiB of RAM,
# so this image would fit.
INITRAMFS_MAXSIZE = "393216"
```

## conf/machine/include/qcom-qcs404.inc
```bitbake
SOC_FAMILY = "qcs404"
require conf/machine/include/soc-family.inc
require conf/machine/include/arm/arch-armv8a.inc

PREFERRED_PROVIDER_virtual/kernel ?= "linux-linaro-qcomlt"

MACHINE_ESSENTIAL_EXTRA_RRECOMMENDS += " \
    qrtr \
"

# Fastboot expects an ext4 image, which needs to be 4096 aligned
IMAGE_FSTYPES ?= "ext4.gz"
IMAGE_ROOTFS_ALIGNMENT = "4096"

QCOM_BOOTIMG_KERNEL_BASE ?= "0x80000000"
QCOM_BOOTIMG_PAGE_SIZE ?= "4096"
```

## conf/machine/include/qcom-sm8250.inc
```bitbake
SOC_FAMILY = "sm8250"
require conf/machine/include/qcom-common.inc
require conf/machine/include/arm/arch-armv8a.inc

MACHINE_ESSENTIAL_EXTRA_RRECOMMENDS += " \
    pd-mapper \
    qrtr \
    rmtfs \
    tqftpserv \
"

MACHINE_EXTRA_RRECOMMENDS += " \
    fastrpc \
"
```

## conf/machine/nexus7-2013.conf
```bitbake
#@TYPE: Machine
#@NAME: Nexus 7 2013
#@DESCRIPTION: 32-bit machine configuration for the Asus Google Nexus 7 2013, with Qualcomm Snapdragon S4 Pro (APQ8064).

require conf/machine/include/qcom-apq8064.inc

MACHINE_FEATURES = "alsa screen wifi bluetooth ext2 ext3 usb usbhost usbgadget"

KERNEL_IMAGETYPE ?= "zImage"
KERNEL_DEVICETREE ?= "qcom-apq8064-asus-nexus7-flo.dtb"

MACHINE_ESSENTIAL_EXTRA_RRECOMMENDS += " \
    ${@bb.utils.contains('DISTRO_FEATURES', 'opengl', 'mesa-driver-msm', '', d)} \
"

SERIAL_CONSOLE ?= "115200 ttyMSM0"

QCOM_BOOTIMG_ROOTFS ?= "PARTLABEL=userdata"
```

## conf/machine/qcom-armv7a-modem.conf
```bitbake
#@TYPE: Machine
#@NAME: Qualcomm SDX/MDM devices
#@DESCRIPTION: Machine configuration for various Qualcomm SDX and MDM based boards

require conf/machine/include/qcom-common.inc
# MDM9615 is Cortex-A5 + VFP4, so it should be compatible
require conf/machine/include/arm/armv7a/tune-cortexa7.inc

MACHINE_FEATURES = "usbhost usbgadget"

MACHINE_ESSENTIAL_EXTRA_RRECOMMENDS += " \
    qrtr \
    rmtfs \
"

KERNEL_IMAGETYPE ?= "zImage"
KERNEL_DEVICETREE ?= " \
    qcom/qcom-mdm9615-wp8548-mangoh-green.dtb \
    qcom/qcom-sdx55-mtp.dtb \
    qcom/qcom-sdx55-t55.dtb \
    qcom/qcom-sdx55-telit-fn980-tlb.dtb \
    qcom/qcom-sdx65-mtp.dtb \
"

SERIAL_CONSOLES[qcom-sdx55-telit-fn980-tlb] = "921600;ttyMSM0"

# UBI filesystem settings
IMAGE_FSTYPES ?= "ubi"
QCOM_BOOTIMG_PAGE_SIZE ?= "4096"

# UBI filesystem parameters
MKUBIFS_ARGS ?= "-m 4096 -e 253952 -c 1188"
UBINIZE_ARGS ?= "-m 4096 -p 256KiB -s 4096"

# Use system partition for rootfs
UBI_VOLNAME ?= "system"
QCOM_BOOTIMG_ROOTFS ?= "ubi0:system"
```

## conf/machine/qcom-armv8a.conf
```bitbake
require conf/machine/include/qcom-common.inc
require conf/machine/include/arm/arch-armv8a.inc

MACHINE_FEATURES = "usbhost usbgadget alsa screen wifi bluetooth ext2"

# UFS partitions in 820/845/RB5 setup with 4096 logical sector size
EXTRA_IMAGECMD_ext4 += " -b 4096 "

# Support for dragonboard{410, 820, 845}c, rb5
KERNEL_IMAGETYPE ?= "Image.gz"
SERIAL_CONSOLE ?= "115200 ttyMSM0"
KERNEL_DEVICETREE ?= "qcom/apq8016-sbc.dtb qcom/apq8096-db820c.dtb qcom/sdm845-db845c.dtb qcom/qrb5165-rb5.dtb qcom/sm8250-rb5-dvt.dtb"

QCOM_BOOTIMG_PAGE_SIZE[apq8016-sbc] = "2048"
QCOM_BOOTIMG_ROOTFS = "/dev/sda1"
QCOM_BOOTIMG_ROOTFS[apq8016-sbc] = "/dev/mmcblk0p14"
SD_QCOM_BOOTIMG_ROOTFS[apq8016-sbc] = "/dev/mmcblk1p7"
KERNEL_CMDLINE_EXTRA[sdm845-db845c] = "clk_ignore_unused pd_ignore_unused"

# Userspace tools
MACHINE_ESSENTIAL_EXTRA_RRECOMMENDS += " \
    pd-mapper \
    qrtr \
    rmtfs \
    tqftpserv \
"

MACHINE_EXTRA_RRECOMMENDS += " \
    fastrpc \
"

# Modules and firmware for all supported machines
MACHINE_ESSENTIAL_EXTRA_RRECOMMENDS += " \
    kernel-modules \
    firmware-qcom-dragonboard410c \
    firmware-qcom-dragonboard820c \
    firmware-qcom-dragonboard845c \
    firmware-qcom-rb5 \
    ${@bb.utils.contains('DISTRO_FEATURES', 'wifi', 'linux-firmware-ath10k linux-firmware-ath11k linux-firmware-qcom-sdm845-modem wireless-regdb-static', '', d)} \
    ${@bb.utils.contains('DISTRO_FEATURES', 'bluetooth', 'linux-firmware-qca linux-firmware-qcom-sdm845-modem', '', d)} \
    linux-firmware-qcom-sdm845-audio \
    linux-firmware-qcom-sdm845-compute \
    linux-firmware-qcom-sm8250-audio \
    linux-firmware-qcom-sm8250-compute \
    ${@bb.utils.contains('DISTRO_FEATURES', 'opengl', 'linux-firmware-qcom-adreno-a3xx linux-firmware-qcom-adreno-a530 linux-firmware-qcom-adreno-a630 linux-firmware-qcom-adreno-a650', '', d)} \
    linux-firmware-qcom-venus-1.8 \
    linux-firmware-qcom-venus-4.2 \
    linux-firmware-qcom-venus-5.2 \
    linux-firmware-qcom-vpu-1.0 \
"
```

## conf/machine/qrb5165-rb5.conf
```bitbake
#@TYPE: Machine
#@NAME: RB5 Robotics platform
#@DESCRIPTION: Machine configuration for the RB5 development board, with Qualcomm Snapdragon 865 QRB5165.

require conf/machine/include/qcom-sm8250.inc

MACHINE_FEATURES = "usbhost usbgadget alsa screen wifi bluetooth ext2"

KERNEL_IMAGETYPE ?= "Image.gz"
KERNEL_DEVICETREE ?= "qcom/qrb5165-rb5.dtb qcom/sm8250-rb5-dvt.dtb"
KERNEL_CMDLINE_EXTRA ?= "pcie_pme=nomsi"

SERIAL_CONSOLE ?= "115200 ttyMSM0"

MACHINE_ESSENTIAL_EXTRA_RRECOMMENDS += " \
    kernel-modules \
    ${@bb.utils.contains('DISTRO_FEATURES', 'opengl', 'mesa-driver-msm', '', d)} \
    packagegroup-firmware-rb5 \
    ${@bb.utils.contains('DISTRO_FEATURES', 'wifi', 'wireless-regdb-static', '', d)} \
"

# /dev/sda1 is 'rootfs' partition after installing the latest bootloader package from linaro
QCOM_BOOTIMG_ROOTFS ?= "/dev/sda1"

# UFS partitions setup with 4096 logical sector size
EXTRA_IMAGECMD:ext4 += " -b 4096 "
```

## conf/machine/sa8155p-adp.conf
```bitbake
#@TYPE: Machine
#@NAME: SA8155P-ADP
#@DESCRIPTION: Machine configuration for the SA8155P-ADP development board, with Qualcomm Snapdragon 855 SM8150.

require conf/machine/include/qcom-sa8155p.inc

# Set INITRAMFS_IMAGE for sa8155p machine
INITRAMFS_IMAGE = "initramfs-kerneltest-full-image"

MACHINE_FEATURES = "usbhost usbgadget ext2"

KERNEL_IMAGETYPE ?= "Image.gz"
KERNEL_DEVICETREE ?= "qcom/sa8155p-adp.dtb"

SERIAL_CONSOLE ?= "115200 ttyMSM0"

MACHINE_ESSENTIAL_EXTRA_RRECOMMENDS += " \
    kernel-modules \
"

# /dev/sda6 is 'userdata' partition for adp board, so wipe it and use for our build
QCOM_BOOTIMG_ROOTFS ?= "/dev/sda6"

# UFS partitions setup with 4096 logical sector size
EXTRA_IMAGECMD:ext4 += " -b 4096 "
```
